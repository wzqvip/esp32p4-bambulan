## main/Kconfig.projbuild
```kconfig
menu "拓竹屏配置 (Bambu screen)"

    config BBL_WIFI_SSID
        string "Wi-Fi SSID"
        default ""

    config BBL_WIFI_PASSWORD
        string "Wi-Fi 密码"
        default ""

    config BBL_TIMEZONE
        string "时区 (POSIX TZ)"
        default "CST-8"
        help
            用于显示时钟和预计完成时间。中国用 CST-8。

    config BBL_TLS_VERIFY
        bool "校验打印机 TLS 证书 (BBL CA + 序列号)"
        default y
        help
            打开时用内置的拓竹 CA 证书校验打印机，并把证书 CN 与序列号比对。
            如果连接一直报 TLS 错误，可以先关掉试试。

    config BBL_PRINTER_COUNT
        int "打印机数量"
        range 1 2
        default 2

    menu "打印机 1"
        config BBL_P1_NAME
            string "显示名称"
            default "A1 #1"
        config BBL_P1_HOST
            string "IP 地址"
            default ""
        config BBL_P1_SERIAL
            string "序列号 (SN)"
            default ""
        config BBL_P1_ACCESS_CODE
            string "局域网访问码"
            default ""
    endmenu

    menu "打印机 2"
        depends on BBL_PRINTER_COUNT >= 2
        config BBL_P2_NAME
            string "显示名称"
            default "A1 #2"
        config BBL_P2_HOST
            string "IP 地址"
            default ""
        config BBL_P2_SERIAL
            string "序列号 (SN)"
            default ""
        config BBL_P2_ACCESS_CODE
            string "局域网访问码"
            default ""
    endmenu

    config BBL_LCD_SWAP_BYTES
        bool "RGB565 交换字节（屏幕颜色不对时再打开）"
        default n

    config BBL_BACKLIGHT_PERCENT
        int "屏幕亮度 (%)"
        range 5 100
        default 100

    choice BBL_DISP_MODE
        prompt "屏幕刷新方式"
        default BBL_DISP_PARTIAL_1FB
        help
            实测（V1.0 板）：2 块帧缓冲 + vsync 切换时整屏亮度有可见闪烁（约 ±3%），
            局部渲染 + 1 块帧缓冲（官方例程的方式）不闪，也没有看到撕裂。
        config BBL_DISP_PARTIAL_1FB
            bool "局部渲染 + 1 块帧缓冲（与 ELECROW 官方例程相同，推荐）"
        config BBL_DISP_DIRECT_2FB
            bool "直接渲染到 2 块帧缓冲，vsync 切换（这块屏上会闪）"
    endchoice

    menu "调试 (Debug)"
        config BBL_PAGE_ANIM_MS
            int "切页动画时长 (ms，0 = 直接切换)"
            range 0 1000
            default 0
            help
                滑动动画每帧都要整屏重画（实测约 35~50ms 一帧，只有 18~23fps），
                所以默认直接切换（一帧，约 40~60ms）。想要滑动效果可以设成 200。

        config BBL_DEBUG_PERF
            bool "串口打印渲染耗时和帧率"
            default n
            help
                每 5 秒打印一次平时的渲染统计；每次切页动画结束后打印这次动画的
                帧数、帧率、每帧渲染/等待刷新耗时。

        config BBL_DEBUG_PAGE_CYCLE
            bool "自动在总览和详情页之间来回切换（每 3 秒）"
            default n

        config BBL_DEBUG_NO_CAMERA
            bool "不连接摄像头（排查闪烁用）"
            default n

        config BBL_DEBUG_CAMERA_MODE
            int "摄像头调试模式：0 正常，1 只收不解码，2 解码但不上屏"
            range 0 2
            default 0
            depends on !BBL_DEBUG_NO_CAMERA
            help
                排查闪烁用：分别对应 Wi-Fi 收流 / 硬件 JPEG+PPA / LVGL 重画 三段负载。
    endmenu

endmenu
```

## sdkconfig.defaults
```kconfig
# ---- 芯片与存储 ----
CONFIG_IDF_TARGET="esp32p4"
CONFIG_ESPTOOLPY_FLASHSIZE_16MB=y
CONFIG_ESPTOOLPY_FLASHMODE_QIO=y
CONFIG_PARTITION_TABLE_CUSTOM=y
CONFIG_PARTITION_TABLE_CUSTOM_FILENAME="partitions.csv"
CONFIG_COMPILER_OPTIMIZATION_PERF=y
CONFIG_SPIRAM=y
CONFIG_SPIRAM_MODE_HEX=y
CONFIG_SPIRAM_SPEED_80M=y
CONFIG_SPIRAM_XIP_FROM_PSRAM=y
CONFIG_SPIRAM_MALLOC_ALWAYSINTERNAL=4096
CONFIG_SPIRAM_TRY_ALLOCATE_WIFI_LWIP=y
CONFIG_FREERTOS_HZ=1000
CONFIG_ESP_MAIN_TASK_STACK_SIZE=8192

# ---- 默认按 V1.2 及以上硬件（ESP32-P4 芯片 v1.x）----
CONFIG_ESP32P4_SELECTS_REV_LESS_V3=y
CONFIG_ESP32P4_REV_MIN_100=y

# ---- ESP32-C6 协处理器（esp_hosted over SDIO, V1.2 引脚）----
CONFIG_ESP_HOSTED_ENABLED=y
CONFIG_ESP_HOSTED_P4_DEV_BOARD_NONE=y
CONFIG_ESP_HOSTED_SDIO_HOST_INTERFACE=y
CONFIG_SLAVE_IDF_TARGET_ESP32C6=y
CONFIG_ESP_HOSTED_SDIO_SLOT_1=y
CONFIG_ESP_HOSTED_SDIO_4_BIT_BUS=y
CONFIG_ESP_HOSTED_SDIO_CLOCK_FREQ_KHZ=40000
CONFIG_ESP_HOSTED_SDIO_RESET_ACTIVE_HIGH=y
CONFIG_ESP_HOSTED_PRIV_SDIO_PIN_CMD_SLOT_1=19
CONFIG_ESP_HOSTED_PRIV_SDIO_PIN_CLK_SLOT_1=18
CONFIG_ESP_HOSTED_PRIV_SDIO_PIN_D0_SLOT_1=17
CONFIG_ESP_HOSTED_PRIV_SDIO_PIN_D1_4BIT_BUS_SLOT_1=16
CONFIG_ESP_HOSTED_PRIV_SDIO_PIN_D2_4BIT_BUS_SLOT_1=15
CONFIG_ESP_HOSTED_PRIV_SDIO_PIN_D3_4BIT_BUS_SLOT_1=14
CONFIG_ESP_HOSTED_SDIO_GPIO_RESET_SLAVE=54
CONFIG_ESP_HOSTED_SDIO_RESET_DELAY_MS=1500

# ---- TLS / MQTT ----
CONFIG_MBEDTLS_EXTERNAL_MEM_ALLOC=y
CONFIG_MBEDTLS_SSL_IN_CONTENT_LEN=16384
CONFIG_MBEDTLS_SSL_OUT_CONTENT_LEN=4096
CONFIG_MBEDTLS_DYNAMIC_BUFFER=y
CONFIG_ESP_TLS_INSECURE=y
CONFIG_ESP_TLS_SKIP_SERVER_CERT_VERIFY=y
CONFIG_MQTT_PROTOCOL_311=y
CONFIG_LWIP_SNTP_MAX_SERVERS=2

# ---- LVGL 9 ----
CONFIG_LV_COLOR_DEPTH_16=y
CONFIG_LV_OS_NONE=y
CONFIG_LV_USE_CLIB_MALLOC=y
CONFIG_LV_USE_CLIB_STRING=y
CONFIG_LV_USE_CLIB_SPRINTF=y
CONFIG_LV_DEF_REFR_PERIOD=15
CONFIG_LV_FONT_MONTSERRAT_14=y
CONFIG_LV_FONT_MONTSERRAT_20=y
CONFIG_LV_FONT_MONTSERRAT_28=y
CONFIG_LV_USE_FONT_COMPRESSED=y
CONFIG_LV_FONT_FMT_TXT_LARGE=y
CONFIG_LV_USE_MSGBOX=y
CONFIG_LV_USE_ARC=y
CONFIG_LV_USE_SLIDER=y
CONFIG_LV_USE_SWITCH=y
CONFIG_LV_USE_BUTTONMATRIX=y
CONFIG_LV_THEME_DEFAULT_DARK=y
CONFIG_LV_USE_PERF_MONITOR=n
```
